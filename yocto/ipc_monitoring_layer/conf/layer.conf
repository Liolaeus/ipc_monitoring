## yocto/ipc_monitoring_layer/conf/layer.conf
```bitbake
BBPATH .= ":${LAYERDIR}"

BBFILES += "${LAYERDIR}/recipes-*/*/*.bb \
            ${LAYERDIR}/recipes-*/*/*.bbappend"

BBFILE_COLLECTIONS += "ipc-monitoring"
BBFILE_PATTERN_ipc-monitoring = "^${LAYERDIR}/"
BBFILE_PRIORITY_ipc-monitoring = "6"

LAYERDEPENDS_ipc-monitoring = "core"
LAYERSERIES_COMPAT_ipc-monitoring = "wrynose"
```

## yocto/ipc_monitoring_layer/conf/local.conf
```bitbake
CONF_VERSION = "2"

IMAGE_INSTALL:append = " ipc-monitoring"

DISTRO_FEATURES:append = " systemd usrmerge"
DISTRO_FEATURES:remove = "sysvinit"
VIRTUAL-RUNTIME_init_manager = "systemd"
VIRTUAL-RUNTIME_initscripts = ""

# allow root login with no passwd
EXTRA_IMAGE_FEATURES += "allow-empty-password allow-root-login empty-root-password"
```
